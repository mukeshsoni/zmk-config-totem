## config/west.yml
```yaml
manifest:
  remotes:
    - name: zmkfirmware
      url-base: https://github.com/zmkfirmware
  projects:
    - name: zmk
      remote: zmkfirmware
      revision: 118359c83efa0758144489fd5e12cc6f5bdbad4c
      import: app/west.yml
  self:
    path: config
```
